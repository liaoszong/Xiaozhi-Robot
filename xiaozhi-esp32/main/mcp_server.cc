/*
 * MCP Server Implementation
 * Reference: https://modelcontextprotocol.io/specification/2024-11-05
 */

#include "mcp_server.h"
#include <esp_log.h>
#include <esp_app_desc.h>
#include <algorithm>
#include <cstring>
#include <esp_pthread.h>
#include <map>
#include <vector>
#include <sstream>
#include <cctype>
#include <cstdlib>
#include <atomic>
#include <stdexcept>
#include <freertos/FreeRTOS.h>
#include <freertos/task.h>

#include "application.h"
#include "display.h"
#include "oled_display.h"
#include "board.h"
#include "settings.h"
#include "lvgl_theme.h"
#include "lvgl_display.h"
#include "uart_controller.h"

#define TAG "MCP"


namespace {

struct CarSequenceStep {
    std::string action;
    char command;
    int duration_ms;
};

enum CarMissionState {
    kMissionIdle = 0,
    kMissionDelivering,
    kMissionWaitingMedicine,
    kMissionReturning,
    kMissionCancelled,
};

struct CarSequenceTaskArgs {
    std::vector<CarSequenceStep> steps;
    CarMissionState final_state;
};

static std::atomic_bool s_car_sequence_running{false};
static std::atomic_bool s_car_sequence_cancel_requested{false};
static std::atomic_int s_car_mission_state{kMissionIdle};
static constexpr int kFixedAngleTurnWaitMs = 1800;

static const std::map<std::string, char>& GetStm32CarCommandMap() {
    // Keep this table aligned with STM32 Hardware/Bluetooth.h:
    // CMD_FORWARD='A', CMD_BACKWARD='E', CMD_LEFT='G', CMD_RIGHT='C',
    // CMD_STOP='Z', CMD_LEFT_UP='H', CMD_RIGHT_UP='B',
    // CMD_LEFT_DOWN='F', CMD_RIGHT_DOWN='D'.
    static const std::map<std::string, char> stm32_command_map = {
        {"forward", 'A'},
        {"backward", 'E'},
        {"left", 'G'},
        {"right", 'C'},
        {"stop", 'Z'},
        {"left_forward", 'H'},
        {"right_forward", 'B'},
        {"left_backward", 'F'},
        {"right_backward", 'D'}
    };
    return stm32_command_map;
}

static std::string Trim(const std::string& text) {
    size_t begin = 0;
    while (begin < text.size() && std::isspace(static_cast<unsigned char>(text[begin]))) {
        begin++;
    }

    size_t end = text.size();
    while (end > begin && std::isspace(static_cast<unsigned char>(text[end - 1]))) {
        end--;
    }

    return text.substr(begin, end - begin);
}

static std::string ToLowerAscii(std::string text) {
    std::transform(text.begin(), text.end(), text.begin(), [](unsigned char c) {
        return static_cast<char>(std::tolower(c));
    });
    return text;
}

static int ParseDurationMs(const std::string& raw_duration) {
    std::string text = ToLowerAscii(Trim(raw_duration));
    if (text.empty()) {
        return 0;
    }

    // Accept values generated by the LLM such as 3000, 3000ms, 3s, or 3秒.
    bool seconds_unit = false;
    if (text.find("ms") != std::string::npos) {
        seconds_unit = false;
    } else if (text.find('s') != std::string::npos || text.find("秒") != std::string::npos) {
        seconds_unit = true;
    }

    char* end = nullptr;
    float value = std::strtof(text.c_str(), &end);
    if (end == text.c_str() || value < 0.0f) {
        throw std::runtime_error("Invalid duration: " + raw_duration);
    }

    int duration_ms = seconds_unit ? static_cast<int>(value * 1000.0f) : static_cast<int>(value);
    if (duration_ms < 0) {
        duration_ms = 0;
    }
    if (duration_ms > 10000) {
        throw std::runtime_error("Each car sequence step must be <= 10000 ms");
    }
    return duration_ms;
}

static std::vector<CarSequenceStep> ParseCarSequence(const std::string& sequence_text) {
    const auto& command_map = GetStm32CarCommandMap();
    std::vector<CarSequenceStep> steps;
    std::string normalized = sequence_text;
    std::replace(normalized.begin(), normalized.end(), ';', ',');
    std::replace(normalized.begin(), normalized.end(), '\n', ',');

    std::stringstream ss(normalized);
    std::string token;
    int total_duration_ms = 0;

    while (std::getline(ss, token, ',')) {
        token = Trim(token);
        if (token.empty()) {
            continue;
        }

        size_t colon = token.find(':');
        if (colon == std::string::npos) {
            throw std::runtime_error("Invalid car sequence step, expected action:duration_ms: " + token);
        }

        std::string action = ToLowerAscii(Trim(token.substr(0, colon)));
        std::string duration_text = Trim(token.substr(colon + 1));

        auto it = command_map.find(action);
        if (it == command_map.end()) {
            throw std::runtime_error("Unknown car action in sequence: " + action);
        }

        int duration_ms = ParseDurationMs(duration_text);
        total_duration_ms += duration_ms;
        if (total_duration_ms > 30000) {
            throw std::runtime_error("Total car sequence duration must be <= 30000 ms");
        }

        steps.push_back(CarSequenceStep{action, it->second, duration_ms});
    }

    if (steps.empty()) {
        throw std::runtime_error("Empty car sequence");
    }

    if (steps.size() > 12) {
        throw std::runtime_error("Car sequence supports at most 12 steps");
    }

    return steps;
}

static const char* MissionStateName(CarMissionState state) {
    switch (state) {
        case kMissionIdle:
            return "IDLE";
        case kMissionDelivering:
            return "DELIVERING";
        case kMissionWaitingMedicine:
            return "WAITING_MEDICINE";
        case kMissionReturning:
            return "RETURNING";
        case kMissionCancelled:
            return "CANCELLED";
        default:
            return "UNKNOWN";
    }
}

static CarMissionState CurrentMissionState() {
    return static_cast<CarMissionState>(s_car_mission_state.load());
}

static void SetMissionState(CarMissionState state) {
    s_car_mission_state.store(static_cast<int>(state));
}

static bool DelayMsWithCancelCheck(int duration_ms) {
    int remaining_ms = duration_ms;

    while (remaining_ms > 0) {
        if (s_car_sequence_cancel_requested.load()) {
            return true;
        }

        int chunk_ms = std::min(remaining_ms, 100);
        vTaskDelay(pdMS_TO_TICKS(chunk_ms));
        remaining_ms -= chunk_ms;
    }

    return s_car_sequence_cancel_requested.load();
}

static int GetEffectiveSequenceWaitMs(const CarSequenceStep& step) {
    // Left/right are fixed-angle yaw turns on the STM32 side. If the LLM uses
    // left:0 or right:0 in a sequence, wait briefly so the 45-degree turn can
    // complete before sending the next command. Explicit durations still win.
    if ((step.command == 'G' || step.command == 'C') && step.duration_ms == 0) {
        return kFixedAngleTurnWaitMs;
    }
    return step.duration_ms;
}

static void CarSequenceTask(void* arg) {
    auto task_args = static_cast<CarSequenceTaskArgs*>(arg);
    auto& uart = UartController::GetInstance();

    bool sent_stop_at_end = false;
    bool canceled = false;

    for (const auto& step : task_args->steps) {
        if (s_car_sequence_cancel_requested.load()) {
            canceled = true;
            break;
        }

        if (!uart.SendCarCommand(step.command)) {
            ESP_LOGE(TAG, "car sequence failed at action=%s", step.action.c_str());
            break;
        }

        if (step.command == 'Z') {
            sent_stop_at_end = true;
        } else {
            sent_stop_at_end = false;
        }

        int wait_ms = GetEffectiveSequenceWaitMs(step);
        if (wait_ms > 0 && DelayMsWithCancelCheck(wait_ms)) {
            canceled = true;
            break;
        }
    }

    if (canceled) {
        // The stop command that requested cancellation has already sent CAR:Z.
        // Do not send another stop frame here, otherwise logs and acknowledgements
        // become harder to reason about.
        SetMissionState(kMissionCancelled);
        ESP_LOGI(TAG, "car sequence canceled");
    } else if (!sent_stop_at_end) {
        // Safety: a timed sequence should not leave the car moving if the user
        // did not explicitly end with stop.
        uart.SendCarCommand('Z');
        SetMissionState(task_args->final_state);
    } else {
        SetMissionState(task_args->final_state);
    }

    delete task_args;
    s_car_sequence_cancel_requested.store(false);
    s_car_sequence_running.store(false);
    vTaskDelete(nullptr);
}

static void StartCarSequenceTask(std::vector<CarSequenceStep> steps, CarMissionState final_state) {
    bool expected = false;
    if (!s_car_sequence_running.compare_exchange_strong(expected, true)) {
        throw std::runtime_error("A car sequence is already running");
    }
    s_car_sequence_cancel_requested.store(false);

    auto& uart = UartController::GetInstance();
    if (!uart.Initialize()) {
        s_car_sequence_running.store(false);
        throw std::runtime_error("UART controller initialization failed");
    }

    auto* task_args = new CarSequenceTaskArgs{std::move(steps), final_state};
    BaseType_t ret = xTaskCreate(CarSequenceTask,
                                 "car_sequence",
                                 4096,
                                 task_args,
                                 5,
                                 nullptr);
    if (ret != pdPASS) {
        delete task_args;
        s_car_sequence_running.store(false);
        throw std::runtime_error("Failed to start car sequence task");
    }
}

static std::vector<CarSequenceStep> MissionSteps(const std::string& mission) {
    if (mission == "patrol") {
        return ParseCarSequence(
            "forward:1500,right:0,forward:1500,right:0,"
            "forward:1500,right:0,forward:1500,right:0,"
            "forward:1500,right:0,forward:1500,right:0,"
            "forward:1500,right:0,forward:1500,right:0,stop:0");
    }
    if (mission == "demo") {
        return ParseCarSequence(
            "left:0,right:0,right:0,left:0,"
            "backward:1000,forward:1000,left:0,right:0,stop:0");
    }
    if (mission == "self_check") {
        return ParseCarSequence("left:0,right:0,forward:1000,stop:0,backward:1000,stop:0");
    }
    if (mission == "medicine_delivery") {
        return ParseCarSequence("forward:3000,stop:0");
    }
    if (mission == "return_home") {
        return ParseCarSequence("right:0,right:0,right:0,right:0,forward:3000,right:0,right:0,right:0,right:0,stop:0");
    }

    throw std::runtime_error("Unknown car mission: " + mission);
}

} // namespace

McpServer::McpServer() {
}

McpServer::~McpServer() {
    for (auto tool : tools_) {
        delete tool;
    }
    tools_.clear();
}

void McpServer::AddCommonTools() {
    // *Important* To speed up the response time, we add the common tools to the beginning of
    // the tools list to utilize the prompt cache.
    // **重要** 为了提升响应速度，我们把常用的工具放在前面，利用 prompt cache 的特性。

    // Backup the original tools list and restore it after adding the common tools.
    auto original_tools = std::move(tools_);
    auto& board = Board::GetInstance();

    // Do not add custom tools here.
    // Custom tools must be added in the board's InitializeTools function.
    AddTool("self.car.control",
        "Control the smart car with one immediate action. "
        "Use this only for a single action without timing. "
        "For compound or timed instructions, use self.car.sequence instead. "
        "Use action=stop to immediately stop the car and cancel any active sequence. "
        "left/right are fixed-angle 45-degree turns controlled by STM32 yaw feedback. "
        "Actions: forward, backward, left, right, stop, left_forward, right_forward, left_backward, right_backward.",
        PropertyList({
            Property("action", kPropertyTypeString)
        }),
        [](const PropertyList& properties) -> ReturnValue {
            auto action = ToLowerAscii(Trim(properties["action"].value<std::string>()));
            const auto& stm32_command_map = GetStm32CarCommandMap();

            auto it = stm32_command_map.find(action);
            if (it == stm32_command_map.end()) {
                throw std::runtime_error("Unknown car action: " + action);
            }

            auto& uart = UartController::GetInstance();
            if (!uart.Initialize()) {
                throw std::runtime_error("UART controller initialization failed");
            }

            char command = it->second;
            if (command == 'Z' && s_car_sequence_running.load()) {
                s_car_sequence_cancel_requested.store(true);
                SetMissionState(kMissionCancelled);
                ESP_LOGI(TAG, "stop command requested active car sequence cancellation");
            }

            if (!uart.SendCarCommand(command)) {
                throw std::runtime_error("UART command send failed");
            }

            cJSON* json = cJSON_CreateObject();
            cJSON_AddStringToObject(json, "status", "success");
            cJSON_AddStringToObject(json, "action", action.c_str());
            cJSON_AddStringToObject(json, "command", std::string(1, command).c_str());
            return json;
        });

    AddTool("self.car.sequence",
        "Run a timed smart-car action sequence. Use this for compound commands such as "
        "'move forward for 3 seconds, then backward for 3 seconds, then stop'. "
        "The steps argument must be a comma-separated list in the format "
        "action:duration_ms, for example: forward:3000,backward:3000,stop:0. "
        "Accepted actions: forward, backward, left, right, stop, left_forward, right_forward, left_backward, right_backward. "
        "left/right are fixed-angle 45-degree turns; use left:0 or right:0 when the user says turn left/right without a duration. "
        "Durations may also use seconds, for example forward:3s. The sequence auto-sends stop at the end if needed. "
        "If the user interrupts with stop/cancel, call self.car.control action=stop; it cancels the active sequence.",
        PropertyList({
            Property("steps", kPropertyTypeString)
        }),
        [](const PropertyList& properties) -> ReturnValue {
            auto steps_text = properties["steps"].value<std::string>();
            auto steps = ParseCarSequence(steps_text);
            SetMissionState(kMissionIdle);
            StartCarSequenceTask(std::move(steps), kMissionIdle);

            cJSON* json = cJSON_CreateObject();
            cJSON_AddStringToObject(json, "status", "started");
            cJSON_AddStringToObject(json, "steps", steps_text.c_str());
            return json;
        });
    AddTool("self.car.mission",
        "Run a high-level smart-car mission. Use this when the user asks for a task rather than one raw movement. "
        "Supported missions: patrol, demo, medicine_delivery, return_home, self_check. "
        "patrol runs an octagon-like patrol using forward moves and 45-degree right turns. "
        "demo performs a short movement showcase. self_check tests turn, forward, stop, backward, and stop. "
        "medicine_delivery drives forward and then waits for the user to say the medicine is placed. "
        "return_home should be used after medicine_delivery when the user says the medicine has been placed or asks the car to return. "
        "Any active mission can be cancelled by calling self.car.control with action=stop.",
        PropertyList({
            Property("mission", kPropertyTypeString)
        }),
        [](const PropertyList& properties) -> ReturnValue {
            auto mission = ToLowerAscii(Trim(properties["mission"].value<std::string>()));

            if (mission == "cancel" || mission == "stop") {
                s_car_sequence_cancel_requested.store(true);
                SetMissionState(kMissionCancelled);
                UartController::GetInstance().SendCarCommand('Z');

                cJSON* json = cJSON_CreateObject();
                cJSON_AddStringToObject(json, "status", "cancelled");
                cJSON_AddStringToObject(json, "mission_state", MissionStateName(CurrentMissionState()));
                return json;
            }

            CarMissionState current_state = CurrentMissionState();
            CarMissionState running_state = kMissionIdle;
            CarMissionState final_state = kMissionIdle;

            if (mission == "medicine_delivery") {
                if (current_state != kMissionIdle && current_state != kMissionCancelled) {
                    throw std::runtime_error("Car mission is not idle");
                }
                running_state = kMissionDelivering;
                final_state = kMissionWaitingMedicine;
            } else if (mission == "return_home") {
                if (current_state != kMissionWaitingMedicine && current_state != kMissionCancelled) {
                    throw std::runtime_error("No medicine delivery is waiting to return");
                }
                running_state = kMissionReturning;
                final_state = kMissionIdle;
            } else if (mission == "patrol" || mission == "demo" || mission == "self_check") {
                if (current_state != kMissionIdle && current_state != kMissionCancelled) {
                    throw std::runtime_error("Car mission is not idle");
                }
                running_state = kMissionIdle;
                final_state = kMissionIdle;
            } else {
                throw std::runtime_error("Unknown car mission: " + mission);
            }

            auto steps = MissionSteps(mission);
            SetMissionState(running_state);
            try {
                StartCarSequenceTask(std::move(steps), final_state);
            } catch (...) {
                SetMissionState(current_state);
                throw;
            }

            cJSON* json = cJSON_CreateObject();
            cJSON_AddStringToObject(json, "status", "started");
            cJSON_AddStringToObject(json, "mission", mission.c_str());
            cJSON_AddStringToObject(json, "mission_state", MissionStateName(CurrentMissionState()));
            return json;
        });
    AddTool("self.get_device_status",
        "Provides the real-time information of the device, including the current status of the audio speaker, screen, battery, network, etc.\n"
        "Use this tool for: \n"
        "1. Answering questions about current condition (e.g. what is the current volume of the audio speaker?)\n"
        "2. As the first step to control the device (e.g. turn up / down the volume of the audio speaker, etc.)",
        PropertyList(),
        [&board](const PropertyList& properties) -> ReturnValue {
            return board.GetDeviceStatusJson();
        });

    AddTool("self.audio_speaker.set_volume", 
        "Set the volume of the audio speaker. If the current volume is unknown, you must call `self.get_device_status` tool first and then call this tool.",
        PropertyList({
            Property("volume", kPropertyTypeInteger, 0, 100)
        }), 
        [&board](const PropertyList& properties) -> ReturnValue {
            auto codec = board.GetAudioCodec();
            codec->SetOutputVolume(properties["volume"].value<int>());
            return true;
        });
    
    auto backlight = board.GetBacklight();
    if (backlight) {
        AddTool("self.screen.set_brightness",
            "Set the brightness of the screen.",
            PropertyList({
                Property("brightness", kPropertyTypeInteger, 0, 100)
            }),
            [backlight](const PropertyList& properties) -> ReturnValue {
                uint8_t brightness = static_cast<uint8_t>(properties["brightness"].value<int>());
                backlight->SetBrightness(brightness, true);
                return true;
            });
    }

#ifdef HAVE_LVGL
    auto display = board.GetDisplay();
    if (display && display->GetTheme() != nullptr) {
        AddTool("self.screen.set_theme",
            "Set the theme of the screen. The theme can be `light` or `dark`.",
            PropertyList({
                Property("theme", kPropertyTypeString)
            }),
            [display](const PropertyList& properties) -> ReturnValue {
                auto theme_name = properties["theme"].value<std::string>();
                auto& theme_manager = LvglThemeManager::GetInstance();
                auto theme = theme_manager.GetTheme(theme_name);
                if (theme != nullptr) {
                    display->SetTheme(theme);
                    return true;
                }
                return false;
            });
    }

    auto camera = board.GetCamera();
    if (camera) {
        AddTool("self.camera.take_photo",
            "Take a photo and explain it. Use this tool after the user asks you to see something.\n"
            "Args:\n"
            "  `question`: The question that you want to ask about the photo.\n"
            "Return:\n"
            "  A JSON object that provides the photo information.",
            PropertyList({
                Property("question", kPropertyTypeString)
            }),
            [camera](const PropertyList& properties) -> ReturnValue {
                // Lower the priority to do the camera capture
                TaskPriorityReset priority_reset(1);

                if (!camera->Capture()) {
                    throw std::runtime_error("Failed to capture photo");
                }
                auto question = properties["question"].value<std::string>();
                return camera->Explain(question);
            });
    }
#endif

    // Restore the original tools list to the end of the tools list
    tools_.insert(tools_.end(), original_tools.begin(), original_tools.end());
}

void McpServer::AddUserOnlyTools() {
    // System tools
    AddUserOnlyTool("self.get_system_info",
        "Get the system information",
        PropertyList(),
        [this](const PropertyList& properties) -> ReturnValue {
            auto& board = Board::GetInstance();
            return board.GetSystemInfoJson();
        });

    AddUserOnlyTool("self.reboot", "Reboot the system",
        PropertyList(),
        [this](const PropertyList& properties) -> ReturnValue {
            auto& app = Application::GetInstance();
            app.Schedule([&app]() {
                ESP_LOGW(TAG, "User requested reboot");
                vTaskDelay(pdMS_TO_TICKS(1000));

                app.Reboot();
            });
            return true;
        });

    // Firmware upgrade
    AddUserOnlyTool("self.upgrade_firmware", "Upgrade firmware from a specific URL. This will download and install the firmware, then reboot the device.",
        PropertyList({
            Property("url", kPropertyTypeString, "The URL of the firmware binary file to download and install")
        }),
        [this](const PropertyList& properties) -> ReturnValue {
            auto url = properties["url"].value<std::string>();
            ESP_LOGI(TAG, "User requested firmware upgrade from URL: %s", url.c_str());
            
            auto& app = Application::GetInstance();
            app.Schedule([url, &app]() {
                auto ota = std::make_unique<Ota>();
                
                bool success = app.UpgradeFirmware(*ota, url);
                if (!success) {
                    ESP_LOGE(TAG, "Firmware upgrade failed");
                }
            });
            
            return true;
        });

    // Display control
#ifdef HAVE_LVGL
    auto display = dynamic_cast<LvglDisplay*>(Board::GetInstance().GetDisplay());
    if (display) {
        AddUserOnlyTool("self.screen.get_info", "Information about the screen, including width, height, etc.",
            PropertyList(),
            [display](const PropertyList& properties) -> ReturnValue {
                cJSON *json = cJSON_CreateObject();
                cJSON_AddNumberToObject(json, "width", display->width());
                cJSON_AddNumberToObject(json, "height", display->height());
                if (dynamic_cast<OledDisplay*>(display)) {
                    cJSON_AddBoolToObject(json, "monochrome", true);
                } else {
                    cJSON_AddBoolToObject(json, "monochrome", false);
                }
                return json;
            });

#if CONFIG_LV_USE_SNAPSHOT
        AddUserOnlyTool("self.screen.snapshot", "Snapshot the screen and upload it to a specific URL",
            PropertyList({
                Property("url", kPropertyTypeString),
                Property("quality", kPropertyTypeInteger, 80, 1, 100)
            }),
            [display](const PropertyList& properties) -> ReturnValue {
                auto url = properties["url"].value<std::string>();
                auto quality = properties["quality"].value<int>();

                std::string jpeg_data;
                if (!display->SnapshotToJpeg(jpeg_data, quality)) {
                    throw std::runtime_error("Failed to snapshot screen");
                }

                ESP_LOGI(TAG, "Upload snapshot %u bytes to %s", jpeg_data.size(), url.c_str());
                
                // 构造multipart/form-data请求体
                std::string boundary = "----ESP32_SCREEN_SNAPSHOT_BOUNDARY";
                
                auto http = Board::GetInstance().GetNetwork()->CreateHttp(3);
                http->SetHeader("Content-Type", "multipart/form-data; boundary=" + boundary);
                if (!http->Open("POST", url)) {
                    throw std::runtime_error("Failed to open URL: " + url);
                }
                {
                    // 文件字段头部
                    std::string file_header;
                    file_header += "--" + boundary + "\r\n";
                    file_header += "Content-Disposition: form-data; name=\"file\"; filename=\"screenshot.jpg\"\r\n";
                    file_header += "Content-Type: image/jpeg\r\n";
                    file_header += "\r\n";
                    http->Write(file_header.c_str(), file_header.size());
                }

                // JPEG数据
                http->Write((const char*)jpeg_data.data(), jpeg_data.size());

                {
                    // multipart尾部
                    std::string multipart_footer;
                    multipart_footer += "\r\n--" + boundary + "--\r\n";
                    http->Write(multipart_footer.c_str(), multipart_footer.size());
                }
                http->Write("", 0);

                if (http->GetStatusCode() != 200) {
                    throw std::runtime_error("Unexpected status code: " + std::to_string(http->GetStatusCode()));
                }
                std::string result = http->ReadAll();
                http->Close();
                ESP_LOGI(TAG, "Snapshot screen result: %s", result.c_str());
                return true;
            });
        
        AddUserOnlyTool("self.screen.preview_image", "Preview an image on the screen",
            PropertyList({
                Property("url", kPropertyTypeString)
            }),
            [display](const PropertyList& properties) -> ReturnValue {
                auto url = properties["url"].value<std::string>();
                auto http = Board::GetInstance().GetNetwork()->CreateHttp(3);

                if (!http->Open("GET", url)) {
                    throw std::runtime_error("Failed to open URL: " + url);
                }
                int status_code = http->GetStatusCode();
                if (status_code != 200) {
                    throw std::runtime_error("Unexpected status code: " + std::to_string(status_code));
                }

                size_t content_length = http->GetBodyLength();
                char* data = (char*)heap_caps_malloc(content_length, MALLOC_CAP_8BIT);
                if (data == nullptr) {
                    throw std::runtime_error("Failed to allocate memory for image: " + url);
                }
                size_t total_read = 0;
                while (total_read < content_length) {
                    int ret = http->Read(data + total_read, content_length - total_read);
                    if (ret < 0) {
                        heap_caps_free(data);
                        throw std::runtime_error("Failed to download image: " + url);
                    }
                    if (ret == 0) {
                        break;
                    }
                    total_read += ret;
                }
                http->Close();

                auto image = std::make_unique<LvglAllocatedImage>(data, content_length);
                display->SetPreviewImage(std::move(image));
                return true;
            });
#endif // CONFIG_LV_USE_SNAPSHOT
    }
#endif // HAVE_LVGL

    // Assets download url
    auto& assets = Assets::GetInstance();
    if (assets.partition_valid()) {
        AddUserOnlyTool("self.assets.set_download_url", "Set the download url for the assets",
            PropertyList({
                Property("url", kPropertyTypeString)
            }),
            [](const PropertyList& properties) -> ReturnValue {
                auto url = properties["url"].value<std::string>();
                Settings settings("assets", true);
                settings.SetString("download_url", url);
                return true;
            });
    }
}

void McpServer::AddTool(McpTool* tool) {
    // Prevent adding duplicate tools
    if (std::find_if(tools_.begin(), tools_.end(), [tool](const McpTool* t) { return t->name() == tool->name(); }) != tools_.end()) {
        ESP_LOGW(TAG, "Tool %s already added", tool->name().c_str());
        return;
    }

    ESP_LOGI(TAG, "Add tool: %s%s", tool->name().c_str(), tool->user_only() ? " [user]" : "");
    tools_.push_back(tool);
}

void McpServer::AddTool(const std::string& name, const std::string& description, const PropertyList& properties, std::function<ReturnValue(const PropertyList&)> callback) {
    AddTool(new McpTool(name, description, properties, callback));
}

void McpServer::AddUserOnlyTool(const std::string& name, const std::string& description, const PropertyList& properties, std::function<ReturnValue(const PropertyList&)> callback) {
    auto tool = new McpTool(name, description, properties, callback);
    tool->set_user_only(true);
    AddTool(tool);
}

void McpServer::ParseMessage(const std::string& message) {
    cJSON* json = cJSON_Parse(message.c_str());
    if (json == nullptr) {
        ESP_LOGE(TAG, "Failed to parse MCP message: %s", message.c_str());
        return;
    }
    ParseMessage(json);
    cJSON_Delete(json);
}

void McpServer::ParseCapabilities(const cJSON* capabilities) {
    auto vision = cJSON_GetObjectItem(capabilities, "vision");
    if (cJSON_IsObject(vision)) {
        auto url = cJSON_GetObjectItem(vision, "url");
        auto token = cJSON_GetObjectItem(vision, "token");
        if (cJSON_IsString(url)) {
            auto camera = Board::GetInstance().GetCamera();
            if (camera) {
                std::string url_str = std::string(url->valuestring);
                std::string token_str;
                if (cJSON_IsString(token)) {
                    token_str = std::string(token->valuestring);
                }
                camera->SetExplainUrl(url_str, token_str);
            }
        }
    }
}

void McpServer::ParseMessage(const cJSON* json) {
    // Check JSONRPC version
    auto version = cJSON_GetObjectItem(json, "jsonrpc");
    if (version == nullptr || !cJSON_IsString(version) || strcmp(version->valuestring, "2.0") != 0) {
        ESP_LOGE(TAG, "Invalid JSONRPC version: %s", version ? version->valuestring : "null");
        return;
    }
    
    // Check method
    auto method = cJSON_GetObjectItem(json, "method");
    if (method == nullptr || !cJSON_IsString(method)) {
        ESP_LOGE(TAG, "Missing method");
        return;
    }
    
    auto method_str = std::string(method->valuestring);
    if (method_str.find("notifications") == 0) {
        return;
    }
    
    // Check params
    auto params = cJSON_GetObjectItem(json, "params");
    if (params != nullptr && !cJSON_IsObject(params)) {
        ESP_LOGE(TAG, "Invalid params for method: %s", method_str.c_str());
        return;
    }

    auto id = cJSON_GetObjectItem(json, "id");
    if (id == nullptr || !cJSON_IsNumber(id)) {
        ESP_LOGE(TAG, "Invalid id for method: %s", method_str.c_str());
        return;
    }
    auto id_int = id->valueint;
    
    if (method_str == "initialize") {
        if (cJSON_IsObject(params)) {
            auto capabilities = cJSON_GetObjectItem(params, "capabilities");
            if (cJSON_IsObject(capabilities)) {
                ParseCapabilities(capabilities);
            }
        }
        auto app_desc = esp_app_get_description();
        std::string message = "{\"protocolVersion\":\"2024-11-05\",\"capabilities\":{\"tools\":{}},\"serverInfo\":{\"name\":\"" BOARD_NAME "\",\"version\":\"";
        message += app_desc->version;
        message += "\"}}";
        ReplyResult(id_int, message);
    } else if (method_str == "tools/list") {
        std::string cursor_str = "";
        bool list_user_only_tools = false;
        if (params != nullptr) {
            auto cursor = cJSON_GetObjectItem(params, "cursor");
            if (cJSON_IsString(cursor)) {
                cursor_str = std::string(cursor->valuestring);
            }
            auto with_user_tools = cJSON_GetObjectItem(params, "withUserTools");
            if (cJSON_IsBool(with_user_tools)) {
                list_user_only_tools = with_user_tools->valueint == 1;
            }
        }
        GetToolsList(id_int, cursor_str, list_user_only_tools);
    } else if (method_str == "tools/call") {
        if (!cJSON_IsObject(params)) {
            ESP_LOGE(TAG, "tools/call: Missing params");
            ReplyError(id_int, "Missing params");
            return;
        }
        auto tool_name = cJSON_GetObjectItem(params, "name");
        if (!cJSON_IsString(tool_name)) {
            ESP_LOGE(TAG, "tools/call: Missing name");
            ReplyError(id_int, "Missing name");
            return;
        }
        auto tool_arguments = cJSON_GetObjectItem(params, "arguments");
        if (tool_arguments != nullptr && !cJSON_IsObject(tool_arguments)) {
            ESP_LOGE(TAG, "tools/call: Invalid arguments");
            ReplyError(id_int, "Invalid arguments");
            return;
        }
        DoToolCall(id_int, std::string(tool_name->valuestring), tool_arguments);
    } else {
        ESP_LOGE(TAG, "Method not implemented: %s", method_str.c_str());
        ReplyError(id_int, "Method not implemented: " + method_str);
    }
}

void McpServer::ReplyResult(int id, const std::string& result) {
    std::string payload = "{\"jsonrpc\":\"2.0\",\"id\":";
    payload += std::to_string(id) + ",\"result\":";
    payload += result;
    payload += "}";
    Application::GetInstance().SendMcpMessage(payload);
}

void McpServer::ReplyError(int id, const std::string& message) {
    std::string payload = "{\"jsonrpc\":\"2.0\",\"id\":";
    payload += std::to_string(id);
    payload += ",\"error\":{\"message\":\"";
    payload += message;
    payload += "\"}}";
    Application::GetInstance().SendMcpMessage(payload);
}

void McpServer::GetToolsList(int id, const std::string& cursor, bool list_user_only_tools) {
    const int max_payload_size = 8000;
    std::string json = "{\"tools\":[";
    
    bool found_cursor = cursor.empty();
    auto it = tools_.begin();
    std::string next_cursor = "";
    
    while (it != tools_.end()) {
        // 如果我们还没有找到起始位置，继续搜索
        if (!found_cursor) {
            if ((*it)->name() == cursor) {
                found_cursor = true;
            } else {
                ++it;
                continue;
            }
        }

        if (!list_user_only_tools && (*it)->user_only()) {
            ++it;
            continue;
        }
        
        // 添加tool前检查大小
        std::string tool_json = (*it)->to_json() + ",";
        if (json.length() + tool_json.length() + 30 > max_payload_size) {
            // 如果添加这个tool会超出大小限制，设置next_cursor并退出循环
            next_cursor = (*it)->name();
            break;
        }
        
        json += tool_json;
        ++it;
    }
    
    if (json.back() == ',') {
        json.pop_back();
    }
    
    if (json.back() == '[' && !tools_.empty()) {
        // 如果没有添加任何tool，返回错误
        ESP_LOGE(TAG, "tools/list: Failed to add tool %s because of payload size limit", next_cursor.c_str());
        ReplyError(id, "Failed to add tool " + next_cursor + " because of payload size limit");
        return;
    }

    if (next_cursor.empty()) {
        json += "]}";
    } else {
        json += "],\"nextCursor\":\"" + next_cursor + "\"}";
    }
    
    ReplyResult(id, json);
}

void McpServer::DoToolCall(int id, const std::string& tool_name, const cJSON* tool_arguments) {
    auto tool_iter = std::find_if(tools_.begin(), tools_.end(), 
                                 [&tool_name](const McpTool* tool) { 
                                     return tool->name() == tool_name; 
                                 });
    
    if (tool_iter == tools_.end()) {
        ESP_LOGE(TAG, "tools/call: Unknown tool: %s", tool_name.c_str());
        ReplyError(id, "Unknown tool: " + tool_name);
        return;
    }

    PropertyList arguments = (*tool_iter)->properties();
    try {
        for (auto& argument : arguments) {
            bool found = false;
            if (cJSON_IsObject(tool_arguments)) {
                auto value = cJSON_GetObjectItem(tool_arguments, argument.name().c_str());
                if (argument.type() == kPropertyTypeBoolean && cJSON_IsBool(value)) {
                    argument.set_value<bool>(value->valueint == 1);
                    found = true;
                } else if (argument.type() == kPropertyTypeInteger && cJSON_IsNumber(value)) {
                    argument.set_value<int>(value->valueint);
                    found = true;
                } else if (argument.type() == kPropertyTypeString && cJSON_IsString(value)) {
                    argument.set_value<std::string>(value->valuestring);
                    found = true;
                }
            }

            if (!argument.has_default_value() && !found) {
                ESP_LOGE(TAG, "tools/call: Missing valid argument: %s", argument.name().c_str());
                ReplyError(id, "Missing valid argument: " + argument.name());
                return;
            }
        }
    } catch (const std::exception& e) {
        ESP_LOGE(TAG, "tools/call: %s", e.what());
        ReplyError(id, e.what());
        return;
    }

    // Use main thread to call the tool
    auto& app = Application::GetInstance();
    app.Schedule([this, id, tool_iter, arguments = std::move(arguments)]() {
        try {
            ReplyResult(id, (*tool_iter)->Call(arguments));
        } catch (const std::exception& e) {
            ESP_LOGE(TAG, "tools/call: %s", e.what());
            ReplyError(id, e.what());
        }
    });
}
